## examples/esp32/main/Kconfig.projbuild
```kconfig
menu "Hermes Lite"

    config HL_API_URL
        string "LLM endpoint (chat completions URL)"
        default "https://www.sui-xiang.net/v1/chat/completions"

    config HL_API_KEY
        string "LLM API bearer key"
        default ""

    config HL_MODEL
        string "Model name"
        default "gpt-6.1-terra"

    config HL_TLS_INSECURE
        bool "Skip TLS certificate verification (insecure; needs CONFIG_ESP_TLS_INSECURE)"
        default n

endmenu
```

## zephyr/Kconfig
```kconfig
menu "Hermes Lite core"

config HL_PLATFORM_ZEPHYR
	bool "Compile the Zephyr platform backend (zsock + mbedTLS + littlefs)"
	default y
	help
	  Real HTTPS/filesystem backend for Zephyr targets. The native_sim
	  sample runs with an in-tree mock platform; real boards use this.

endmenu
```
